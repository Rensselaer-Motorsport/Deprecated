    IF :LNOT::DEF:INCLUDED_CYFITTERRV_INC
INCLUDED_CYFITTERRV_INC EQU 1
    GET cydevicerv_trm.inc

; Pin_1
Pin_1__0__DM__MASK EQU 0xE00000
Pin_1__0__DM__SHIFT EQU 21
Pin_1__0__DR EQU CYREG_PRT0_DR
Pin_1__0__HSIOM EQU CYREG_HSIOM_PORT_SEL0
Pin_1__0__HSIOM_MASK EQU 0xF0000000
Pin_1__0__HSIOM_SHIFT EQU 28
Pin_1__0__INTCFG EQU CYREG_PRT0_INTCFG
Pin_1__0__INTSTAT EQU CYREG_PRT0_INTSTAT
Pin_1__0__MASK EQU 0x80
Pin_1__0__PA__CFG0 EQU CYREG_UDB_PA0_CFG0
Pin_1__0__PA__CFG1 EQU CYREG_UDB_PA0_CFG1
Pin_1__0__PA__CFG10 EQU CYREG_UDB_PA0_CFG10
Pin_1__0__PA__CFG11 EQU CYREG_UDB_PA0_CFG11
Pin_1__0__PA__CFG12 EQU CYREG_UDB_PA0_CFG12
Pin_1__0__PA__CFG13 EQU CYREG_UDB_PA0_CFG13
Pin_1__0__PA__CFG14 EQU CYREG_UDB_PA0_CFG14
Pin_1__0__PA__CFG2 EQU CYREG_UDB_PA0_CFG2
Pin_1__0__PA__CFG3 EQU CYREG_UDB_PA0_CFG3
Pin_1__0__PA__CFG4 EQU CYREG_UDB_PA0_CFG4
Pin_1__0__PA__CFG5 EQU CYREG_UDB_PA0_CFG5
Pin_1__0__PA__CFG6 EQU CYREG_UDB_PA0_CFG6
Pin_1__0__PA__CFG7 EQU CYREG_UDB_PA0_CFG7
Pin_1__0__PA__CFG8 EQU CYREG_UDB_PA0_CFG8
Pin_1__0__PA__CFG9 EQU CYREG_UDB_PA0_CFG9
Pin_1__0__PC EQU CYREG_PRT0_PC
Pin_1__0__PC2 EQU CYREG_PRT0_PC2
Pin_1__0__PORT EQU 0
Pin_1__0__PS EQU CYREG_PRT0_PS
Pin_1__0__SHIFT EQU 7
Pin_1__DR EQU CYREG_PRT0_DR
Pin_1__INTCFG EQU CYREG_PRT0_INTCFG
Pin_1__INTSTAT EQU CYREG_PRT0_INTSTAT
Pin_1__MASK EQU 0x80
Pin_1__PA__CFG0 EQU CYREG_UDB_PA0_CFG0
Pin_1__PA__CFG1 EQU CYREG_UDB_PA0_CFG1
Pin_1__PA__CFG10 EQU CYREG_UDB_PA0_CFG10
Pin_1__PA__CFG11 EQU CYREG_UDB_PA0_CFG11
Pin_1__PA__CFG12 EQU CYREG_UDB_PA0_CFG12
Pin_1__PA__CFG13 EQU CYREG_UDB_PA0_CFG13
Pin_1__PA__CFG14 EQU CYREG_UDB_PA0_CFG14
Pin_1__PA__CFG2 EQU CYREG_UDB_PA0_CFG2
Pin_1__PA__CFG3 EQU CYREG_UDB_PA0_CFG3
Pin_1__PA__CFG4 EQU CYREG_UDB_PA0_CFG4
Pin_1__PA__CFG5 EQU CYREG_UDB_PA0_CFG5
Pin_1__PA__CFG6 EQU CYREG_UDB_PA0_CFG6
Pin_1__PA__CFG7 EQU CYREG_UDB_PA0_CFG7
Pin_1__PA__CFG8 EQU CYREG_UDB_PA0_CFG8
Pin_1__PA__CFG9 EQU CYREG_UDB_PA0_CFG9
Pin_1__PC EQU CYREG_PRT0_PC
Pin_1__PC2 EQU CYREG_PRT0_PC2
Pin_1__PORT EQU 0
Pin_1__PS EQU CYREG_PRT0_PS
Pin_1__SHIFT EQU 7

; Up_Shift_Air
Up_Shift_Air__0__DM__MASK EQU 0x38
Up_Shift_Air__0__DM__SHIFT EQU 3
Up_Shift_Air__0__DR EQU CYREG_PRT4_DR
Up_Shift_Air__0__HSIOM EQU CYREG_HSIOM_PORT_SEL4
Up_Shift_Air__0__HSIOM_MASK EQU 0x000000F0
Up_Shift_Air__0__HSIOM_SHIFT EQU 4
Up_Shift_Air__0__INTCFG EQU CYREG_PRT4_INTCFG
Up_Shift_Air__0__INTSTAT EQU CYREG_PRT4_INTSTAT
Up_Shift_Air__0__MASK EQU 0x02
Up_Shift_Air__0__PC EQU CYREG_PRT4_PC
Up_Shift_Air__0__PC2 EQU CYREG_PRT4_PC2
Up_Shift_Air__0__PORT EQU 4
Up_Shift_Air__0__PS EQU CYREG_PRT4_PS
Up_Shift_Air__0__SHIFT EQU 1
Up_Shift_Air__DR EQU CYREG_PRT4_DR
Up_Shift_Air__INTCFG EQU CYREG_PRT4_INTCFG
Up_Shift_Air__INTSTAT EQU CYREG_PRT4_INTSTAT
Up_Shift_Air__MASK EQU 0x02
Up_Shift_Air__PC EQU CYREG_PRT4_PC
Up_Shift_Air__PC2 EQU CYREG_PRT4_PC2
Up_Shift_Air__PORT EQU 4
Up_Shift_Air__PS EQU CYREG_PRT4_PS
Up_Shift_Air__SHIFT EQU 1

; Engage_Clutch
Engage_Clutch__0__DM__MASK EQU 0x07
Engage_Clutch__0__DM__SHIFT EQU 0
Engage_Clutch__0__DR EQU CYREG_PRT4_DR
Engage_Clutch__0__HSIOM EQU CYREG_HSIOM_PORT_SEL4
Engage_Clutch__0__HSIOM_MASK EQU 0x0000000F
Engage_Clutch__0__HSIOM_SHIFT EQU 0
Engage_Clutch__0__INTCFG EQU CYREG_PRT4_INTCFG
Engage_Clutch__0__INTSTAT EQU CYREG_PRT4_INTSTAT
Engage_Clutch__0__MASK EQU 0x01
Engage_Clutch__0__PC EQU CYREG_PRT4_PC
Engage_Clutch__0__PC2 EQU CYREG_PRT4_PC2
Engage_Clutch__0__PORT EQU 4
Engage_Clutch__0__PS EQU CYREG_PRT4_PS
Engage_Clutch__0__SHIFT EQU 0
Engage_Clutch__DR EQU CYREG_PRT4_DR
Engage_Clutch__INTCFG EQU CYREG_PRT4_INTCFG
Engage_Clutch__INTSTAT EQU CYREG_PRT4_INTSTAT
Engage_Clutch__MASK EQU 0x01
Engage_Clutch__PC EQU CYREG_PRT4_PC
Engage_Clutch__PC2 EQU CYREG_PRT4_PC2
Engage_Clutch__PORT EQU 4
Engage_Clutch__PS EQU CYREG_PRT4_PS
Engage_Clutch__SHIFT EQU 0

; Down_Shift_Air
Down_Shift_Air__0__DM__MASK EQU 0xE00
Down_Shift_Air__0__DM__SHIFT EQU 9
Down_Shift_Air__0__DR EQU CYREG_PRT4_DR
Down_Shift_Air__0__HSIOM EQU CYREG_HSIOM_PORT_SEL4
Down_Shift_Air__0__HSIOM_MASK EQU 0x0000F000
Down_Shift_Air__0__HSIOM_SHIFT EQU 12
Down_Shift_Air__0__INTCFG EQU CYREG_PRT4_INTCFG
Down_Shift_Air__0__INTSTAT EQU CYREG_PRT4_INTSTAT
Down_Shift_Air__0__MASK EQU 0x08
Down_Shift_Air__0__PC EQU CYREG_PRT4_PC
Down_Shift_Air__0__PC2 EQU CYREG_PRT4_PC2
Down_Shift_Air__0__PORT EQU 4
Down_Shift_Air__0__PS EQU CYREG_PRT4_PS
Down_Shift_Air__0__SHIFT EQU 3
Down_Shift_Air__DR EQU CYREG_PRT4_DR
Down_Shift_Air__INTCFG EQU CYREG_PRT4_INTCFG
Down_Shift_Air__INTSTAT EQU CYREG_PRT4_INTSTAT
Down_Shift_Air__MASK EQU 0x08
Down_Shift_Air__PC EQU CYREG_PRT4_PC
Down_Shift_Air__PC2 EQU CYREG_PRT4_PC2
Down_Shift_Air__PORT EQU 4
Down_Shift_Air__PS EQU CYREG_PRT4_PS
Down_Shift_Air__SHIFT EQU 3

; Steering_Wheel
Steering_Wheel__0__DM__MASK EQU 0x1C0
Steering_Wheel__0__DM__SHIFT EQU 6
Steering_Wheel__0__DR EQU CYREG_PRT0_DR
Steering_Wheel__0__HSIOM EQU CYREG_HSIOM_PORT_SEL0
Steering_Wheel__0__HSIOM_MASK EQU 0x00000F00
Steering_Wheel__0__HSIOM_SHIFT EQU 8
Steering_Wheel__0__INTCFG EQU CYREG_PRT0_INTCFG
Steering_Wheel__0__INTSTAT EQU CYREG_PRT0_INTSTAT
Steering_Wheel__0__MASK EQU 0x04
Steering_Wheel__0__PA__CFG0 EQU CYREG_UDB_PA0_CFG0
Steering_Wheel__0__PA__CFG1 EQU CYREG_UDB_PA0_CFG1
Steering_Wheel__0__PA__CFG10 EQU CYREG_UDB_PA0_CFG10
Steering_Wheel__0__PA__CFG11 EQU CYREG_UDB_PA0_CFG11
Steering_Wheel__0__PA__CFG12 EQU CYREG_UDB_PA0_CFG12
Steering_Wheel__0__PA__CFG13 EQU CYREG_UDB_PA0_CFG13
Steering_Wheel__0__PA__CFG14 EQU CYREG_UDB_PA0_CFG14
Steering_Wheel__0__PA__CFG2 EQU CYREG_UDB_PA0_CFG2
Steering_Wheel__0__PA__CFG3 EQU CYREG_UDB_PA0_CFG3
Steering_Wheel__0__PA__CFG4 EQU CYREG_UDB_PA0_CFG4
Steering_Wheel__0__PA__CFG5 EQU CYREG_UDB_PA0_CFG5
Steering_Wheel__0__PA__CFG6 EQU CYREG_UDB_PA0_CFG6
Steering_Wheel__0__PA__CFG7 EQU CYREG_UDB_PA0_CFG7
Steering_Wheel__0__PA__CFG8 EQU CYREG_UDB_PA0_CFG8
Steering_Wheel__0__PA__CFG9 EQU CYREG_UDB_PA0_CFG9
Steering_Wheel__0__PC EQU CYREG_PRT0_PC
Steering_Wheel__0__PC2 EQU CYREG_PRT0_PC2
Steering_Wheel__0__PORT EQU 0
Steering_Wheel__0__PS EQU CYREG_PRT0_PS
Steering_Wheel__0__SHIFT EQU 2
Steering_Wheel__1__DM__MASK EQU 0xE00
Steering_Wheel__1__DM__SHIFT EQU 9
Steering_Wheel__1__DR EQU CYREG_PRT0_DR
Steering_Wheel__1__HSIOM EQU CYREG_HSIOM_PORT_SEL0
Steering_Wheel__1__HSIOM_MASK EQU 0x0000F000
Steering_Wheel__1__HSIOM_SHIFT EQU 12
Steering_Wheel__1__INTCFG EQU CYREG_PRT0_INTCFG
Steering_Wheel__1__INTSTAT EQU CYREG_PRT0_INTSTAT
Steering_Wheel__1__MASK EQU 0x08
Steering_Wheel__1__PA__CFG0 EQU CYREG_UDB_PA0_CFG0
Steering_Wheel__1__PA__CFG1 EQU CYREG_UDB_PA0_CFG1
Steering_Wheel__1__PA__CFG10 EQU CYREG_UDB_PA0_CFG10
Steering_Wheel__1__PA__CFG11 EQU CYREG_UDB_PA0_CFG11
Steering_Wheel__1__PA__CFG12 EQU CYREG_UDB_PA0_CFG12
Steering_Wheel__1__PA__CFG13 EQU CYREG_UDB_PA0_CFG13
Steering_Wheel__1__PA__CFG14 EQU CYREG_UDB_PA0_CFG14
Steering_Wheel__1__PA__CFG2 EQU CYREG_UDB_PA0_CFG2
Steering_Wheel__1__PA__CFG3 EQU CYREG_UDB_PA0_CFG3
Steering_Wheel__1__PA__CFG4 EQU CYREG_UDB_PA0_CFG4
Steering_Wheel__1__PA__CFG5 EQU CYREG_UDB_PA0_CFG5
Steering_Wheel__1__PA__CFG6 EQU CYREG_UDB_PA0_CFG6
Steering_Wheel__1__PA__CFG7 EQU CYREG_UDB_PA0_CFG7
Steering_Wheel__1__PA__CFG8 EQU CYREG_UDB_PA0_CFG8
Steering_Wheel__1__PA__CFG9 EQU CYREG_UDB_PA0_CFG9
Steering_Wheel__1__PC EQU CYREG_PRT0_PC
Steering_Wheel__1__PC2 EQU CYREG_PRT0_PC2
Steering_Wheel__1__PORT EQU 0
Steering_Wheel__1__PS EQU CYREG_PRT0_PS
Steering_Wheel__1__SHIFT EQU 3
Steering_Wheel__2__DM__MASK EQU 0x7000
Steering_Wheel__2__DM__SHIFT EQU 12
Steering_Wheel__2__DR EQU CYREG_PRT0_DR
Steering_Wheel__2__HSIOM EQU CYREG_HSIOM_PORT_SEL0
Steering_Wheel__2__HSIOM_MASK EQU 0x000F0000
Steering_Wheel__2__HSIOM_SHIFT EQU 16
Steering_Wheel__2__INTCFG EQU CYREG_PRT0_INTCFG
Steering_Wheel__2__INTSTAT EQU CYREG_PRT0_INTSTAT
Steering_Wheel__2__MASK EQU 0x10
Steering_Wheel__2__PA__CFG0 EQU CYREG_UDB_PA0_CFG0
Steering_Wheel__2__PA__CFG1 EQU CYREG_UDB_PA0_CFG1
Steering_Wheel__2__PA__CFG10 EQU CYREG_UDB_PA0_CFG10
Steering_Wheel__2__PA__CFG11 EQU CYREG_UDB_PA0_CFG11
Steering_Wheel__2__PA__CFG12 EQU CYREG_UDB_PA0_CFG12
Steering_Wheel__2__PA__CFG13 EQU CYREG_UDB_PA0_CFG13
Steering_Wheel__2__PA__CFG14 EQU CYREG_UDB_PA0_CFG14
Steering_Wheel__2__PA__CFG2 EQU CYREG_UDB_PA0_CFG2
Steering_Wheel__2__PA__CFG3 EQU CYREG_UDB_PA0_CFG3
Steering_Wheel__2__PA__CFG4 EQU CYREG_UDB_PA0_CFG4
Steering_Wheel__2__PA__CFG5 EQU CYREG_UDB_PA0_CFG5
Steering_Wheel__2__PA__CFG6 EQU CYREG_UDB_PA0_CFG6
Steering_Wheel__2__PA__CFG7 EQU CYREG_UDB_PA0_CFG7
Steering_Wheel__2__PA__CFG8 EQU CYREG_UDB_PA0_CFG8
Steering_Wheel__2__PA__CFG9 EQU CYREG_UDB_PA0_CFG9
Steering_Wheel__2__PC EQU CYREG_PRT0_PC
Steering_Wheel__2__PC2 EQU CYREG_PRT0_PC2
Steering_Wheel__2__PORT EQU 0
Steering_Wheel__2__PS EQU CYREG_PRT0_PS
Steering_Wheel__2__SHIFT EQU 4
Steering_Wheel__Clutch__DM__MASK EQU 0x7000
Steering_Wheel__Clutch__DM__SHIFT EQU 12
Steering_Wheel__Clutch__DR EQU CYREG_PRT0_DR
Steering_Wheel__Clutch__INTCFG EQU CYREG_PRT0_INTCFG
Steering_Wheel__Clutch__INTSTAT EQU CYREG_PRT0_INTSTAT
Steering_Wheel__Clutch__MASK EQU 0x10
Steering_Wheel__Clutch__PA__CFG0 EQU CYREG_UDB_PA0_CFG0
Steering_Wheel__Clutch__PA__CFG1 EQU CYREG_UDB_PA0_CFG1
Steering_Wheel__Clutch__PA__CFG10 EQU CYREG_UDB_PA0_CFG10
Steering_Wheel__Clutch__PA__CFG11 EQU CYREG_UDB_PA0_CFG11
Steering_Wheel__Clutch__PA__CFG12 EQU CYREG_UDB_PA0_CFG12
Steering_Wheel__Clutch__PA__CFG13 EQU CYREG_UDB_PA0_CFG13
Steering_Wheel__Clutch__PA__CFG14 EQU CYREG_UDB_PA0_CFG14
Steering_Wheel__Clutch__PA__CFG2 EQU CYREG_UDB_PA0_CFG2
Steering_Wheel__Clutch__PA__CFG3 EQU CYREG_UDB_PA0_CFG3
Steering_Wheel__Clutch__PA__CFG4 EQU CYREG_UDB_PA0_CFG4
Steering_Wheel__Clutch__PA__CFG5 EQU CYREG_UDB_PA0_CFG5
Steering_Wheel__Clutch__PA__CFG6 EQU CYREG_UDB_PA0_CFG6
Steering_Wheel__Clutch__PA__CFG7 EQU CYREG_UDB_PA0_CFG7
Steering_Wheel__Clutch__PA__CFG8 EQU CYREG_UDB_PA0_CFG8
Steering_Wheel__Clutch__PA__CFG9 EQU CYREG_UDB_PA0_CFG9
Steering_Wheel__Clutch__PC EQU CYREG_PRT0_PC
Steering_Wheel__Clutch__PC2 EQU CYREG_PRT0_PC2
Steering_Wheel__Clutch__PORT EQU 0
Steering_Wheel__Clutch__PS EQU CYREG_PRT0_PS
Steering_Wheel__Clutch__SHIFT EQU 4
Steering_Wheel__Down_Shift__DM__MASK EQU 0x1C0
Steering_Wheel__Down_Shift__DM__SHIFT EQU 6
Steering_Wheel__Down_Shift__DR EQU CYREG_PRT0_DR
Steering_Wheel__Down_Shift__INTCFG EQU CYREG_PRT0_INTCFG
Steering_Wheel__Down_Shift__INTSTAT EQU CYREG_PRT0_INTSTAT
Steering_Wheel__Down_Shift__MASK EQU 0x04
Steering_Wheel__Down_Shift__PA__CFG0 EQU CYREG_UDB_PA0_CFG0
Steering_Wheel__Down_Shift__PA__CFG1 EQU CYREG_UDB_PA0_CFG1
Steering_Wheel__Down_Shift__PA__CFG10 EQU CYREG_UDB_PA0_CFG10
Steering_Wheel__Down_Shift__PA__CFG11 EQU CYREG_UDB_PA0_CFG11
Steering_Wheel__Down_Shift__PA__CFG12 EQU CYREG_UDB_PA0_CFG12
Steering_Wheel__Down_Shift__PA__CFG13 EQU CYREG_UDB_PA0_CFG13
Steering_Wheel__Down_Shift__PA__CFG14 EQU CYREG_UDB_PA0_CFG14
Steering_Wheel__Down_Shift__PA__CFG2 EQU CYREG_UDB_PA0_CFG2
Steering_Wheel__Down_Shift__PA__CFG3 EQU CYREG_UDB_PA0_CFG3
Steering_Wheel__Down_Shift__PA__CFG4 EQU CYREG_UDB_PA0_CFG4
Steering_Wheel__Down_Shift__PA__CFG5 EQU CYREG_UDB_PA0_CFG5
Steering_Wheel__Down_Shift__PA__CFG6 EQU CYREG_UDB_PA0_CFG6
Steering_Wheel__Down_Shift__PA__CFG7 EQU CYREG_UDB_PA0_CFG7
Steering_Wheel__Down_Shift__PA__CFG8 EQU CYREG_UDB_PA0_CFG8
Steering_Wheel__Down_Shift__PA__CFG9 EQU CYREG_UDB_PA0_CFG9
Steering_Wheel__Down_Shift__PC EQU CYREG_PRT0_PC
Steering_Wheel__Down_Shift__PC2 EQU CYREG_PRT0_PC2
Steering_Wheel__Down_Shift__PORT EQU 0
Steering_Wheel__Down_Shift__PS EQU CYREG_PRT0_PS
Steering_Wheel__Down_Shift__SHIFT EQU 2
Steering_Wheel__DR EQU CYREG_PRT0_DR
Steering_Wheel__INTCFG EQU CYREG_PRT0_INTCFG
Steering_Wheel__INTSTAT EQU CYREG_PRT0_INTSTAT
Steering_Wheel__MASK EQU 0x1C
Steering_Wheel__PA__CFG0 EQU CYREG_UDB_PA0_CFG0
Steering_Wheel__PA__CFG1 EQU CYREG_UDB_PA0_CFG1
Steering_Wheel__PA__CFG10 EQU CYREG_UDB_PA0_CFG10
Steering_Wheel__PA__CFG11 EQU CYREG_UDB_PA0_CFG11
Steering_Wheel__PA__CFG12 EQU CYREG_UDB_PA0_CFG12
Steering_Wheel__PA__CFG13 EQU CYREG_UDB_PA0_CFG13
Steering_Wheel__PA__CFG14 EQU CYREG_UDB_PA0_CFG14
Steering_Wheel__PA__CFG2 EQU CYREG_UDB_PA0_CFG2
Steering_Wheel__PA__CFG3 EQU CYREG_UDB_PA0_CFG3
Steering_Wheel__PA__CFG4 EQU CYREG_UDB_PA0_CFG4
Steering_Wheel__PA__CFG5 EQU CYREG_UDB_PA0_CFG5
Steering_Wheel__PA__CFG6 EQU CYREG_UDB_PA0_CFG6
Steering_Wheel__PA__CFG7 EQU CYREG_UDB_PA0_CFG7
Steering_Wheel__PA__CFG8 EQU CYREG_UDB_PA0_CFG8
Steering_Wheel__PA__CFG9 EQU CYREG_UDB_PA0_CFG9
Steering_Wheel__PC EQU CYREG_PRT0_PC
Steering_Wheel__PC2 EQU CYREG_PRT0_PC2
Steering_Wheel__PORT EQU 0
Steering_Wheel__PS EQU CYREG_PRT0_PS
Steering_Wheel__SHIFT EQU 2
Steering_Wheel__Up_Shift__DM__MASK EQU 0xE00
Steering_Wheel__Up_Shift__DM__SHIFT EQU 9
Steering_Wheel__Up_Shift__DR EQU CYREG_PRT0_DR
Steering_Wheel__Up_Shift__INTCFG EQU CYREG_PRT0_INTCFG
Steering_Wheel__Up_Shift__INTSTAT EQU CYREG_PRT0_INTSTAT
Steering_Wheel__Up_Shift__MASK EQU 0x08
Steering_Wheel__Up_Shift__PA__CFG0 EQU CYREG_UDB_PA0_CFG0
Steering_Wheel__Up_Shift__PA__CFG1 EQU CYREG_UDB_PA0_CFG1
Steering_Wheel__Up_Shift__PA__CFG10 EQU CYREG_UDB_PA0_CFG10
Steering_Wheel__Up_Shift__PA__CFG11 EQU CYREG_UDB_PA0_CFG11
Steering_Wheel__Up_Shift__PA__CFG12 EQU CYREG_UDB_PA0_CFG12
Steering_Wheel__Up_Shift__PA__CFG13 EQU CYREG_UDB_PA0_CFG13
Steering_Wheel__Up_Shift__PA__CFG14 EQU CYREG_UDB_PA0_CFG14
Steering_Wheel__Up_Shift__PA__CFG2 EQU CYREG_UDB_PA0_CFG2
Steering_Wheel__Up_Shift__PA__CFG3 EQU CYREG_UDB_PA0_CFG3
Steering_Wheel__Up_Shift__PA__CFG4 EQU CYREG_UDB_PA0_CFG4
Steering_Wheel__Up_Shift__PA__CFG5 EQU CYREG_UDB_PA0_CFG5
Steering_Wheel__Up_Shift__PA__CFG6 EQU CYREG_UDB_PA0_CFG6
Steering_Wheel__Up_Shift__PA__CFG7 EQU CYREG_UDB_PA0_CFG7
Steering_Wheel__Up_Shift__PA__CFG8 EQU CYREG_UDB_PA0_CFG8
Steering_Wheel__Up_Shift__PA__CFG9 EQU CYREG_UDB_PA0_CFG9
Steering_Wheel__Up_Shift__PC EQU CYREG_PRT0_PC
Steering_Wheel__Up_Shift__PC2 EQU CYREG_PRT0_PC2
Steering_Wheel__Up_Shift__PORT EQU 0
Steering_Wheel__Up_Shift__PS EQU CYREG_PRT0_PS
Steering_Wheel__Up_Shift__SHIFT EQU 3

; Miscellaneous
CYDEV_BCLK__HFCLK__HZ EQU 24000000
CYDEV_BCLK__HFCLK__KHZ EQU 24000
CYDEV_BCLK__HFCLK__MHZ EQU 24
CYDEV_BCLK__SYSCLK__HZ EQU 24000000
CYDEV_BCLK__SYSCLK__KHZ EQU 24000
CYDEV_BCLK__SYSCLK__MHZ EQU 24
CYDEV_CHIP_DIE_LEOPARD EQU 1
CYDEV_CHIP_DIE_PANTHER EQU 6
CYDEV_CHIP_DIE_PSOC4A EQU 3
CYDEV_CHIP_DIE_PSOC5LP EQU 5
CYDEV_CHIP_DIE_UNKNOWN EQU 0
CYDEV_CHIP_FAMILY_PSOC3 EQU 1
CYDEV_CHIP_FAMILY_PSOC4 EQU 2
CYDEV_CHIP_FAMILY_PSOC5 EQU 3
CYDEV_CHIP_FAMILY_UNKNOWN EQU 0
CYDEV_CHIP_FAMILY_USED EQU CYDEV_CHIP_FAMILY_PSOC4
CYDEV_CHIP_JTAG_ID EQU 0x04C81193
CYDEV_CHIP_MEMBER_3A EQU 1
CYDEV_CHIP_MEMBER_4A EQU 3
CYDEV_CHIP_MEMBER_4D EQU 2
CYDEV_CHIP_MEMBER_4F EQU 4
CYDEV_CHIP_MEMBER_5A EQU 6
CYDEV_CHIP_MEMBER_5B EQU 5
CYDEV_CHIP_MEMBER_UNKNOWN EQU 0
CYDEV_CHIP_MEMBER_USED EQU CYDEV_CHIP_MEMBER_4A
CYDEV_CHIP_DIE_EXPECT EQU CYDEV_CHIP_MEMBER_USED
CYDEV_CHIP_DIE_ACTUAL EQU CYDEV_CHIP_DIE_EXPECT
CYDEV_CHIP_REV_LEOPARD_ES1 EQU 0
CYDEV_CHIP_REV_LEOPARD_ES2 EQU 1
CYDEV_CHIP_REV_LEOPARD_ES3 EQU 3
CYDEV_CHIP_REV_LEOPARD_PRODUCTION EQU 3
CYDEV_CHIP_REV_PANTHER_ES0 EQU 0
CYDEV_CHIP_REV_PANTHER_ES1 EQU 1
CYDEV_CHIP_REV_PANTHER_PRODUCTION EQU 1
CYDEV_CHIP_REV_PSOC4A_ES0 EQU 17
CYDEV_CHIP_REV_PSOC4A_PRODUCTION EQU 17
CYDEV_CHIP_REV_PSOC5LP_ES0 EQU 0
CYDEV_CHIP_REV_PSOC5LP_PRODUCTION EQU 0
CYDEV_CHIP_REVISION_3A_ES1 EQU 0
CYDEV_CHIP_REVISION_3A_ES2 EQU 1
CYDEV_CHIP_REVISION_3A_ES3 EQU 3
CYDEV_CHIP_REVISION_3A_PRODUCTION EQU 3
CYDEV_CHIP_REVISION_4A_ES0 EQU 17
CYDEV_CHIP_REVISION_4A_PRODUCTION EQU 17
CYDEV_CHIP_REVISION_4D_PRODUCTION EQU 0
CYDEV_CHIP_REVISION_4F_PRODUCTION EQU 0
CYDEV_CHIP_REVISION_5A_ES0 EQU 0
CYDEV_CHIP_REVISION_5A_ES1 EQU 1
CYDEV_CHIP_REVISION_5A_PRODUCTION EQU 1
CYDEV_CHIP_REVISION_5B_ES0 EQU 0
CYDEV_CHIP_REVISION_5B_PRODUCTION EQU 0
CYDEV_CHIP_REVISION_USED EQU CYDEV_CHIP_REVISION_4A_PRODUCTION
CYDEV_CHIP_REV_EXPECT EQU CYDEV_CHIP_REVISION_USED
CYDEV_CONFIG_READ_ACCELERATOR EQU 1
CYDEV_CONFIG_UNUSED_IO_AllowButWarn EQU 0
CYDEV_CONFIG_UNUSED_IO EQU CYDEV_CONFIG_UNUSED_IO_AllowButWarn
CYDEV_CONFIG_UNUSED_IO_AllowWithInfo EQU 1
CYDEV_CONFIG_UNUSED_IO_Disallowed EQU 2
CYDEV_CONFIGURATION_COMPRESSED EQU 1
CYDEV_CONFIGURATION_MODE_COMPRESSED EQU 0
CYDEV_CONFIGURATION_MODE EQU CYDEV_CONFIGURATION_MODE_COMPRESSED
CYDEV_CONFIGURATION_MODE_DMA EQU 2
CYDEV_CONFIGURATION_MODE_UNCOMPRESSED EQU 1
CYDEV_DEBUG_PROTECT_KILL EQU 4
CYDEV_DEBUG_PROTECT_OPEN EQU 1
CYDEV_DEBUG_PROTECT EQU CYDEV_DEBUG_PROTECT_OPEN
CYDEV_DEBUG_PROTECT_PROTECTED EQU 2
CYDEV_DEBUGGING_DPS_Disable EQU 3
CYDEV_DEBUGGING_DPS_SWD EQU 2
CYDEV_DEBUGGING_DPS EQU CYDEV_DEBUGGING_DPS_SWD
CYDEV_DEBUGGING_ENABLE EQU 1
CYDEV_HEAP_SIZE EQU 0x80
CYDEV_PROJ_TYPE EQU 0
CYDEV_PROJ_TYPE_BOOTLOADER EQU 1
CYDEV_PROJ_TYPE_LOADABLE EQU 2
CYDEV_PROJ_TYPE_MULTIAPPBOOTLOADER EQU 3
CYDEV_PROJ_TYPE_STANDARD EQU 0
CYDEV_STACK_SIZE EQU 0x0400
CYDEV_USE_BUNDLED_CMSIS EQU 1
CYDEV_VARIABLE_VDDA EQU 1
CYDEV_VDDA_MV EQU 3300
CYDEV_VDDD_MV EQU 3300
CYIPBLOCK_M0S8_CTBM_VERSION EQU 0
CYIPBLOCK_m0s8cpuss_VERSION EQU 0
CYIPBLOCK_m0s8csd_VERSION EQU 0
CYIPBLOCK_m0s8gpio2_VERSION EQU 0
CYIPBLOCK_m0s8hsiom4a_VERSION EQU 0
CYIPBLOCK_m0s8lcd_VERSION EQU 0
CYIPBLOCK_m0s8lpcomp_VERSION EQU 0
CYIPBLOCK_m0s8pclk_VERSION EQU 0
CYIPBLOCK_m0s8sar_VERSION EQU 0
CYIPBLOCK_m0s8scb_VERSION EQU 0
CYIPBLOCK_m0s8srssv2_VERSION EQU 1
CYIPBLOCK_m0s8tcpwm_VERSION EQU 0
CYIPBLOCK_m0s8udbif_VERSION EQU 0
CYIPBLOCK_S8_GPIO_VERSION EQU 2
CYDEV_BOOTLOADER_ENABLE EQU 0
    ENDIF
    END
